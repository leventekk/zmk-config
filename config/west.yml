## config/west.yml
```yaml
manifest:
  remotes:
    - name: zmkfirmware
      url-base: https://github.com/zmkfirmware
    - name: zmkfirmware-infused-kim
      url-base: https://github.com/infused-kim
  projects:
    - name: zmk
      remote: zmkfirmware-infused-kim
      revision: v2.5.0+zmk-fixes+kim-fixes
      import: app/west.yml
  self:
    path: config
```
